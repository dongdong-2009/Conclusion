#include "oled.h"

#define XLevelL		0x00
#define XLevelH		0x10
#define XLevel	 	((XLevelH&0x0F)*16+XLevelL)
#define Max_Column	128
#define Max_Row		  64
#define	Brightness	0xCF

#define X_WIDTH 128
#define Y_WIDTH 64

const unsigned char F6x8[][6] =
{
    { 0x00, 0x00, 0x00, 0x00, 0x00, 0x00 },   // space
    { 0x00, 0x00, 0x00, 0x2f, 0x00, 0x00 },   // !
    { 0x00, 0x00, 0x07, 0x00, 0x07, 0x00 },   // "
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    { 0x14, 0x14, 0x14, 0x14, 0x14, 0x14 }    // horiz lines
};

const unsigned char F8X16[]=
{
	0x00,0x00,0x00,0x00,0x00,0x00,0x00,0x00,0x00,0x00,0x00,0x00,0x00,0x00,0x00,0x00,// 0
  0x00,0x00,0x00,0xF8,0x00,0x00,0x00,0x00,0x00,0x00,0x00,0x33,0x30,0x00,0x00,0x00,//!1
  0x00,0x10,0x0C,0x06,0x10,0x0C,0x06,0x00,0x00,0x00,0x00,0x00,0x00,0x00,0x00,0x00,//"2
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  0x00,0x06,0x01,0x01,0x02,0x02,0x04,0x04,0x00,0x00,0x00,0x00,0x00,0x00,0x00,0x00,//~94

};

//写数据
void OLED_WrDat(unsigned char data)
{
	unsigned char i=8;
	OLED_DC=1;
  OLED_SCL=0;
  while(i--)
  {
    if(data&0x80){OLED_SDA=1;}
    else{OLED_SDA=0;}
    OLED_SCL=1; 
		__ASM("NOP");
    OLED_SCL=0;   
    data<<=1;    
  }
}

//写命令
void OLED_WrCmd(unsigned char cmd)
{
	unsigned char i=8;
	
	OLED_DC=0;
  OLED_SCL=0;
  while(i--)
  {
    if(cmd&0x80){OLED_SDA=1;}
    else{OLED_SDA=0;}
    OLED_SCL=1;
    __ASM("NOP");
    OLED_SCL=0;  
    cmd<<=1;  
  } 	
}

//设定位置信息
void OLED_Set_Pos(unsigned char x, unsigned char y)
{ 
  OLED_WrCmd(0xb0+y);
  OLED_WrCmd(((x&0xf0)>>4)|0x10);
  OLED_WrCmd((x&0x0f)|0x01); 
} 

//延时函数
void OLED_DLY_ms(unsigned int ms)
{                         
  unsigned int a;
  while(ms)
  {
    a=1335;
    while(a--);
    ms--;
  }
  return;
}

//命令调整
void adjust(unsigned char a)
{
  OLED_WrCmd(a);
}

//设定开始列
void SetStartColumn(unsigned char d)
{
	OLED_WrCmd(0x00+d%16);		
	OLED_WrCmd(0x10+d/16);		
}

void SetAddressingMode(unsigned char d)
{
	OLED_WrCmd(0x20);			
	OLED_WrCmd(d);			
}

void SetColumnAddress(unsigned char a, unsigned char b)
{
	OLED_WrCmd(0x21);			
	OLED_WrCmd(a);			
	OLED_WrCmd(b);			
}

void SetPageAddress(unsigned char a, unsigned char b)
{
	OLED_WrCmd(0x22);			
	OLED_WrCmd(a);			
	OLED_WrCmd(b);		
}

void SetStartLine(unsigned char d)
{
	OLED_WrCmd(0x40|d);			
}

void SetContrastControl(unsigned char d)
{
	OLED_WrCmd(0x81);			// Set Contrast Control
	OLED_WrCmd(d);			//   Default => 0x7F
}

void Set_Charge_Pump(unsigned char d)
{
	OLED_WrCmd(0x8D);			// Set Charge Pump
	OLED_WrCmd(0x10|d);			//   Default => 0x10
}

void Set_Segment_Remap(unsigned char d)
{
	OLED_WrCmd(0xA0|d);			// Set Segment Re-Map
}

void Set_Entire_Display(unsigned char d)
{
	OLED_WrCmd(0xA4|d);			// Set Entire Display On / Off
}

void Set_Inverse_Display(unsigned char d)
{
	OLED_WrCmd(0xA6|d);			// Set Inverse Display On/Off
}

void Set_Multiplex_Ratio(unsigned char d)
{
	OLED_WrCmd(0xA8);			// Set Multiplex Ratio
	OLED_WrCmd(d);			//   Default => 0x3F (1/64 Duty)
}

void Set_Display_On_Off(unsigned char d)
{
	OLED_WrCmd(0xAE|d);			// Set Display On/Off
}

void SetStartPage(unsigned char d)
{
	OLED_WrCmd(0xB0|d);			// Set Page Start Address for Page Addressing Mode
}

void Set_Common_Remap(unsigned char d)
{
	OLED_WrCmd(0xC0|d);			// Set COM Output Scan Direction
}

void Set_Display_Offset(unsigned char d)
{
	OLED_WrCmd(0xD3);			// Set Display Offset
	OLED_WrCmd(d);			//   Default => 0x00
}

void Set_Display_Clock(unsigned char d)
{
	OLED_WrCmd(0xD5);			// Set Display Clock Divide Ratio / Oscillator Frequency
	OLED_WrCmd(d);			//   Default => 0x80
}

void Set_Precharge_Period(unsigned char d)
{
	OLED_WrCmd(0xD9);			// Set Pre-Charge Period
	OLED_WrCmd(d);			//   Default => 0x22 (2 Display Clocks [Phase 2] / 2 Display Clocks [Phase 1])
}

void Set_Common_Config(unsigned char d)
{
	OLED_WrCmd(0xDA);			// Set COM Pins Hardware Configuration
	OLED_WrCmd(0x02|d);			//   Default => 0x12 (0x10)
}

void Set_VCOMH(unsigned char d)
{
	OLED_WrCmd(0xDB);			// Set VCOMH Deselect Level
	OLED_WrCmd(d);			//   Default => 0x20 (0.77*VCC)
}

void Set_NOP(void)
{
	OLED_WrCmd(0xE3);			// Command for No Operation
}

void OLED_Init(void) //initialization
{
	GPIO_InitTypeDef  GPIO_InitStructure;

	RCC_APB2PeriphClockCmd(RCC_APB2Periph_GPIOA|RCC_APB2Periph_GPIOC, ENABLE);	 //使能PA,PC端口时钟

	GPIO_InitStructure.GPIO_Pin = GPIO_Pin_8;				 		 //OLED_SCL-->PA.8 端口配置
	GPIO_InitStructure.GPIO_Mode = GPIO_Mode_Out_PP; 		 //推挽输出
	GPIO_InitStructure.GPIO_Speed = GPIO_Speed_50MHz;		 //IO口速度为50MHz
	GPIO_Init(GPIOA, &GPIO_InitStructure);					 	     //根据设定参数初始化GPIOA.8
	GPIO_SetBits(GPIOA,GPIO_Pin_8);						 			     //PA.8 输出高

	GPIO_InitStructure.GPIO_Pin = GPIO_Pin_7;	    		   //OLED_DC-->PC.7 端口配置, 推挽输出
	GPIO_Init(GPIOC, &GPIO_InitStructure);	  				     //推挽输出 ，IO口速度为50MHz
	GPIO_SetBits(GPIOC,GPIO_Pin_7); 						 			     //PC.7 输出高 

	GPIO_InitStructure.GPIO_Pin = GPIO_Pin_8;	    		   //OLED_RST-->PC.8 端口配置, 推挽输出
	GPIO_Init(GPIOC, &GPIO_InitStructure);	  				     //推挽输出 ，IO口速度为50MHz
	GPIO_SetBits(GPIOC,GPIO_Pin_8); 						 			     //PC.7 输出高 

	GPIO_InitStructure.GPIO_Pin = GPIO_Pin_9;	    		   //OLED_SDA-->PC.9 端口配置, 推挽输出
	GPIO_Init(GPIOC, &GPIO_InitStructure);	  				     //推挽输出 ，IO口速度为50MHz

	GPIO_SetBits(GPIOC,GPIO_Pin_9); 						 			     //PC.7 输出高 

	
	OLED_SCL=1;	
	OLED_RST=0;
	OLED_DLY_ms(50);
	OLED_RST=1;
  Set_Display_On_Off(0x00);		  // Display Off (0x00/0x01)
  Set_Display_Clock(0x80);		  // Set Clock as 100 Frames/Sec
  Set_Multiplex_Ratio(0x3F);		// 1/64 Duty (0x0F~0x3F)
  Set_Display_Offset(0x00);		  // Shift Mapping RAM Counter (0x00~0x3F)
  SetStartLine(0x00);			      // Set Mapping RAM Display Start Line (0x00~0x3F)
  Set_Charge_Pump(0x04);		    // Enable Embedded DC/DC Converter (0x00/0x04)
  SetAddressingMode(0x02);		  // Set Page Addressing Mode (0x00/0x01/0x02)
  Set_Segment_Remap(0x01);		  // Set SEG/Column Mapping     0x00???? 0x01??
  Set_Common_Remap(0x08);			  // Set COM/Row Scan Direction 0x00???? 0x08??
  Set_Common_Config(0x10);		  // Set Sequential Configuration (0x00/0x10)
  SetContrastControl(Brightness);	// Set SEG Output Current
  Set_Precharge_Period(0xF1);		// Set Pre-Charge as 15 Clocks & Discharge as 1 Clock
  Set_VCOMH(0x40);			        // Set VCOM Deselect Level
  Set_Entire_Display(0x00);		  // Disable Entire Display On (0x00/0x01)
  Set_Inverse_Display(0x00);		// Disable Inverse Display On (0x00/0x01)  
  Set_Display_On_Off(0x01);		  // Display On (0x00/0x01)
  OLED_Fill(0x00);  //
	OLED_Set_Pos(0,0); 
}

void OLED_P6x8Str(unsigned char x,unsigned char y, char ch[])
{
  unsigned char c=0,i=0,j=0;      
  while (ch[j]!='\0')
  {    
    c =ch[j]-32;
    if(x>120){x=0;y++;}
    OLED_Set_Pos(x,y);    
  	for(i=0;i<6;i++)     
  	  OLED_WrDat(F6x8[c][i]);  
  	x+=6;
  	j++;
  }
}

void OLED_Fill(unsigned char bmp_data)
{
	unsigned char y,x;
	for(y=0;y<8;y++)
	{
		OLED_WrCmd(0xb0+y);
		OLED_WrCmd(0x01);
		OLED_WrCmd(0x10);
		for(x=0;x<X_WIDTH;x++)
			OLED_WrDat(bmp_data);
	}
}

void Disp_Char(unsigned char y,unsigned char x,unsigned char asc)
{
	char ch2[2];
	x=x*8;        
	ch2[0] = asc;	
	ch2[1] = '\0';
	OLED_P6x8Str(x , y , ch2);
}

void Disp_Num(unsigned char y, unsigned char x, unsigned int num,unsigned char N)
{
  unsigned char j=0;
  char n[6]={0};
  x=x*8;
  n[0]=(num/10000)%10; 
  n[1]=(num/1000)%10;
  n[2]=(num/100)%10;
  n[3]=(num/10)%10;
  n[4]=num%10;
  n[5]='\0';    
  for(j=0;j<5;j++) n[j]=n[j]+48;
  OLED_P6x8Str(x,y,&n[5-N]);
}
